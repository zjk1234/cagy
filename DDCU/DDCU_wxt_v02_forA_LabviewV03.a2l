/******************************************************************************
* ASAP2 file: DDCU_wxt_v02_forA_LabviewV03.a2l
* Code generation for model "DDCU_wxt_v02_forA_LabviewV03".
* Model version : 1.786
* Simulink Coder version : 8.6 (R2014a) 27-Dec-2013
* C source code generated on : Tue Mar 19 16:20:29 2019
* Target selection: ec5744.tlc
* Embedded hardware selection: Freescale MPC5500
* Code generation objectives: Unspecified
* Validation result: Not run
* (add additional file header information here)
******************************************************************************/ ASAP2_VERSION 1 31
/* Version 1.31 */
/begin PROJECT ECUCoderProject "ECUCoder Project"
/begin HEADER "Header Comments go here" /end HEADER
/begin MODULE ModuleName "No Comment"
/begin MOD_PAR "No Comment" /end MOD_PAR
/begin MOD_COMMON "No Comment" BYTE_ORDER MSB_FIRST /end MOD_COMMON
/begin RECORD_LAYOUT Scalar_BOOLEAN FNC_VALUES 1 UBYTE COLUMN_DIR DIRECT /end RECORD_LAYOUT
/begin RECORD_LAYOUT Scalar_UBYTE FNC_VALUES 1 UBYTE COLUMN_DIR DIRECT /end RECORD_LAYOUT
/begin RECORD_LAYOUT Scalar_BYTE FNC_VALUES 1 SBYTE COLUMN_DIR DIRECT /end RECORD_LAYOUT
/begin RECORD_LAYOUT Scalar_UWORD FNC_VALUES 1 UWORD COLUMN_DIR DIRECT /end RECORD_LAYOUT
/begin RECORD_LAYOUT Scalar_SWORD FNC_VALUES 1 SWORD COLUMN_DIR DIRECT /end RECORD_LAYOUT
/begin RECORD_LAYOUT Scalar_ULONG FNC_VALUES 1 ULONG COLUMN_DIR DIRECT /end RECORD_LAYOUT
/begin RECORD_LAYOUT Scalar_LONG FNC_VALUES 1 SLONG COLUMN_DIR DIRECT /end RECORD_LAYOUT
/begin RECORD_LAYOUT Scalar_FLOAT32_IEEE FNC_VALUES 1 FLOAT32_IEEE COLUMN_DIR DIRECT /end RECORD_LAYOUT
/begin RECORD_LAYOUT Scalar_FLOAT64_IEEE FNC_VALUES 1 FLOAT64_IEEE COLUMN_DIR DIRECT /end RECORD_LAYOUT
/begin RECORD_LAYOUT Lookup1D_BYTE FNC_VALUES 1 SBYTE COLUMN_DIR DIRECT /end RECORD_LAYOUT
/begin RECORD_LAYOUT Lookup1D_X_BYTE AXIS_PTS_X 1 SBYTE INDEX_INCR DIRECT /end RECORD_LAYOUT
/begin RECORD_LAYOUT Lookup1D_UBYTE FNC_VALUES 1 UBYTE COLUMN_DIR DIRECT /end RECORD_LAYOUT
/begin RECORD_LAYOUT Lookup1D_X_UBYTE AXIS_PTS_X 1 UBYTE INDEX_INCR DIRECT /end RECORD_LAYOUT
/begin RECORD_LAYOUT Lookup1D_UWORD FNC_VALUES 1 UWORD COLUMN_DIR DIRECT /end RECORD_LAYOUT
/begin RECORD_LAYOUT Lookup1D_X_UWORD AXIS_PTS_X 1 UWORD INDEX_INCR DIRECT /end RECORD_LAYOUT
/begin RECORD_LAYOUT Lookup1D_WORD FNC_VALUES 1 SWORD COLUMN_DIR DIRECT /end RECORD_LAYOUT
/begin RECORD_LAYOUT Lookup1D_X_WORD AXIS_PTS_X 1 SWORD INDEX_INCR DIRECT /end RECORD_LAYOUT
/begin RECORD_LAYOUT Lookup1D_ULONG FNC_VALUES 1 ULONG COLUMN_DIR DIRECT /end RECORD_LAYOUT
/begin RECORD_LAYOUT Lookup1D_X_ULONG AXIS_PTS_X 1 ULONG INDEX_INCR DIRECT /end RECORD_LAYOUT
/begin RECORD_LAYOUT Lookup1D_SLONG FNC_VALUES 1 SLONG COLUMN_DIR DIRECT /end RECORD_LAYOUT
/begin RECORD_LAYOUT Lookup1D_X_LONG AXIS_PTS_X 1 SLONG INDEX_INCR DIRECT /end RECORD_LAYOUT
/begin RECORD_LAYOUT Lookup1D_FLOAT32_IEEE FNC_VALUES 1 FLOAT32_IEEE COLUMN_DIR DIRECT /end RECORD_LAYOUT
/begin RECORD_LAYOUT Lookup1D_X_FLOAT32_IEEE AXIS_PTS_X 1 FLOAT32_IEEE INDEX_INCR DIRECT /end RECORD_LAYOUT
/begin RECORD_LAYOUT Lookup1D_FLOAT64_IEEE FNC_VALUES 1 FLOAT64_IEEE COLUMN_DIR DIRECT /end RECORD_LAYOUT
/begin RECORD_LAYOUT Lookup1D_X_FLOAT64_IEEE AXIS_PTS_X 1 FLOAT64_IEEE INDEX_INCR DIRECT /end RECORD_LAYOUT
/begin RECORD_LAYOUT Lookup2D_UBYTE FNC_VALUES 1 UBYTE COLUMN_DIR DIRECT /end RECORD_LAYOUT
/begin RECORD_LAYOUT Lookup2D_X_UBYTE AXIS_PTS_X 1 UBYTE INDEX_INCR DIRECT /end RECORD_LAYOUT
/begin RECORD_LAYOUT Lookup2D_BYTE FNC_VALUES 1 SBYTE COLUMN_DIR DIRECT /end RECORD_LAYOUT
/begin RECORD_LAYOUT Lookup2D_X_BYTE AXIS_PTS_X 1 SBYTE INDEX_INCR DIRECT /end RECORD_LAYOUT
/begin RECORD_LAYOUT Lookup2D_UWORD FNC_VALUES 1 UWORD COLUMN_DIR DIRECT /end RECORD_LAYOUT
/begin RECORD_LAYOUT Lookup2D_X_UWORD AXIS_PTS_X 1 UWORD INDEX_INCR DIRECT /end RECORD_LAYOUT
/begin RECORD_LAYOUT Lookup2D_WORD FNC_VALUES 1 SWORD COLUMN_DIR DIRECT /end RECORD_LAYOUT
/begin RECORD_LAYOUT Lookup2D_X_WORD AXIS_PTS_X 1 SWORD INDEX_INCR DIRECT /end RECORD_LAYOUT
/begin RECORD_LAYOUT Lookup2D_ULONG FNC_VALUES 1 ULONG COLUMN_DIR DIRECT /end RECORD_LAYOUT
/begin RECORD_LAYOUT Lookup2D_X_ULONG AXIS_PTS_X 1 ULONG INDEX_INCR DIRECT /end RECORD_LAYOUT
/begin RECORD_LAYOUT Lookup2D_LONG FNC_VALUES 1 SLONG COLUMN_DIR DIRECT /end RECORD_LAYOUT
/begin RECORD_LAYOUT Lookup2D_X_LONG AXIS_PTS_X 1 SLONG INDEX_INCR DIRECT /end RECORD_LAYOUT
/begin RECORD_LAYOUT Lookup2D_FLOAT32_IEEE FNC_VALUES 1 FLOAT32_IEEE COLUMN_DIR DIRECT /end RECORD_LAYOUT
/begin RECORD_LAYOUT Lookup2D_X_FLOAT32_IEEE AXIS_PTS_X 1 FLOAT32_IEEE INDEX_INCR DIRECT /end RECORD_LAYOUT
/begin RECORD_LAYOUT Lookup2D_FLOAT64_IEEE FNC_VALUES 1 FLOAT64_IEEE COLUMN_DIR DIRECT /end RECORD_LAYOUT
/begin RECORD_LAYOUT Lookup2D_X_FLOAT64_IEEE AXIS_PTS_X 1 FLOAT64_IEEE INDEX_INCR DIRECT /end RECORD_LAYOUT
/begin MEASUREMENT mode_dem_out "" FLOAT64_IEEE DDCU_wxt_v02_forA_LabviewV03_CM_double 0 0 -1.7E+308 1.7E+308 ECU_ADDRESS 0x40001168 /end MEASUREMENT
/begin MEASUREMENT aa "" FLOAT64_IEEE DDCU_wxt_v02_forA_LabviewV03_CM_double 0 0 -1.7E+308 1.7E+308 ECU_ADDRESS 0x40001218 /end MEASUREMENT
/begin MEASUREMENT ab "" FLOAT64_IEEE DDCU_wxt_v02_forA_LabviewV03_CM_double 0 0 -1.7E+308 1.7E+308 ECU_ADDRESS 0x40001170 /end MEASUREMENT
/begin MEASUREMENT ac "" FLOAT64_IEEE DDCU_wxt_v02_forA_LabviewV03_CM_double 0 0 -1.7E+308 1.7E+308 ECU_ADDRESS 0x40001270 /end MEASUREMENT
/begin MEASUREMENT ad "" FLOAT64_IEEE DDCU_wxt_v02_forA_LabviewV03_CM_double 0 0 -1.7E+308 1.7E+308 ECU_ADDRESS 0x40001138 /end MEASUREMENT
/begin MEASUREMENT acc_dem "" FLOAT64_IEEE DDCU_wxt_v02_forA_LabviewV03_CM_double 0 0 -1.7E+308 1.7E+308 ECU_ADDRESS 0x400011f0 /end MEASUREMENT
/begin MEASUREMENT M1Speed "" FLOAT64_IEEE DDCU_wxt_v02_forA_LabviewV03_CM_double 0 0 -1.7E+308 1.7E+308 ECU_ADDRESS 0x400012a0 /end MEASUREMENT
/begin MEASUREMENT M3Speed "" FLOAT64_IEEE DDCU_wxt_v02_forA_LabviewV03_CM_double 0 0 -1.7E+308 1.7E+308 ECU_ADDRESS 0x40001248 /end MEASUREMENT
/begin MEASUREMENT M2Speed "" FLOAT64_IEEE DDCU_wxt_v02_forA_LabviewV03_CM_double 0 0 -1.7E+308 1.7E+308 ECU_ADDRESS 0x40001290 /end MEASUREMENT
/begin MEASUREMENT M4Speed "" FLOAT64_IEEE DDCU_wxt_v02_forA_LabviewV03_CM_double 0 0 -1.7E+308 1.7E+308 ECU_ADDRESS 0x40001240 /end MEASUREMENT
/begin MEASUREMENT brake_emerg "" FLOAT64_IEEE DDCU_wxt_v02_forA_LabviewV03_CM_double 0 0 -1.7E+308 1.7E+308 ECU_ADDRESS 0x400011e8 /end MEASUREMENT
/begin MEASUREMENT steer_dem1 "" FLOAT64_IEEE DDCU_wxt_v02_forA_LabviewV03_CM_double 0 0 -1.7E+308 1.7E+308 ECU_ADDRESS 0x40001260 /end MEASUREMENT
/begin MEASUREMENT zhuche "" FLOAT64_IEEE DDCU_wxt_v02_forA_LabviewV03_CM_double 0 0 -1.7E+308 1.7E+308 ECU_ADDRESS 0x400011c8 /end MEASUREMENT
/begin MEASUREMENT zhongxinzhuanxiang "" FLOAT64_IEEE DDCU_wxt_v02_forA_LabviewV03_CM_double 0 0 -1.7E+308 1.7E+308 ECU_ADDRESS 0x40001208 /end MEASUREMENT
/begin MEASUREMENT qianjin "" FLOAT64_IEEE DDCU_wxt_v02_forA_LabviewV03_CM_double 0 0 -1.7E+308 1.7E+308 ECU_ADDRESS 0x400011a0 /end MEASUREMENT
/begin MEASUREMENT kongdang "" FLOAT64_IEEE DDCU_wxt_v02_forA_LabviewV03_CM_double 0 0 -1.7E+308 1.7E+308 ECU_ADDRESS 0x40001230 /end MEASUREMENT
/begin MEASUREMENT daodang "" FLOAT64_IEEE DDCU_wxt_v02_forA_LabviewV03_CM_double 0 0 -1.7E+308 1.7E+308 ECU_ADDRESS 0x400011b8 /end MEASUREMENT
/begin MEASUREMENT mode_dem1 "" FLOAT64_IEEE DDCU_wxt_v02_forA_LabviewV03_CM_double 0 0 -1.7E+308 1.7E+308 ECU_ADDRESS 0x40001228 /end MEASUREMENT
/begin MEASUREMENT guzhang_rr "" FLOAT64_IEEE DDCU_wxt_v02_forA_LabviewV03_CM_double 0 0 -1.7E+308 1.7E+308 ECU_ADDRESS 0x40001190 /end MEASUREMENT
/begin MEASUREMENT guzhang_lf "" FLOAT64_IEEE DDCU_wxt_v02_forA_LabviewV03_CM_double 0 0 -1.7E+308 1.7E+308 ECU_ADDRESS 0x400012b0 /end MEASUREMENT
/begin MEASUREMENT M1TorqueSet "" FLOAT64_IEEE DDCU_wxt_v02_forA_LabviewV03_CM_double 0 0 -1.7E+308 1.7E+308 ECU_ADDRESS 0x400012c8 /end MEASUREMENT
/begin MEASUREMENT M1Mode "" FLOAT64_IEEE DDCU_wxt_v02_forA_LabviewV03_CM_double 0 0 -1.7E+308 1.7E+308 ECU_ADDRESS 0x400012f0 /end MEASUREMENT
/begin MEASUREMENT M1Enable1 "" FLOAT64_IEEE DDCU_wxt_v02_forA_LabviewV03_CM_double 0 0 -1.7E+308 1.7E+308 ECU_ADDRESS 0x40001280 /end MEASUREMENT
/begin MEASUREMENT M1Drive "" FLOAT64_IEEE DDCU_wxt_v02_forA_LabviewV03_CM_double 0 0 -1.7E+308 1.7E+308 ECU_ADDRESS 0x40001210 /end MEASUREMENT
/begin MEASUREMENT M2Enable1 "" FLOAT64_IEEE DDCU_wxt_v02_forA_LabviewV03_CM_double 0 0 -1.7E+308 1.7E+308 ECU_ADDRESS 0x400012e0 /end MEASUREMENT
/begin MEASUREMENT M2TorqueSet "" FLOAT64_IEEE DDCU_wxt_v02_forA_LabviewV03_CM_double 0 0 -1.7E+308 1.7E+308 ECU_ADDRESS 0x40001200 /end MEASUREMENT
/begin MEASUREMENT M2Mode "" FLOAT64_IEEE DDCU_wxt_v02_forA_LabviewV03_CM_double 0 0 -1.7E+308 1.7E+308 ECU_ADDRESS 0x40001250 /end MEASUREMENT
/begin MEASUREMENT M2Drive "" FLOAT64_IEEE DDCU_wxt_v02_forA_LabviewV03_CM_double 0 0 -1.7E+308 1.7E+308 ECU_ADDRESS 0x40001178 /end MEASUREMENT
/begin MEASUREMENT M3TorqueSet "" FLOAT64_IEEE DDCU_wxt_v02_forA_LabviewV03_CM_double 0 0 -1.7E+308 1.7E+308 ECU_ADDRESS 0x400012a8 /end MEASUREMENT
/begin MEASUREMENT M3Mode "" FLOAT64_IEEE DDCU_wxt_v02_forA_LabviewV03_CM_double 0 0 -1.7E+308 1.7E+308 ECU_ADDRESS 0x400011d8 /end MEASUREMENT
/begin MEASUREMENT M3Enable1 "" FLOAT64_IEEE DDCU_wxt_v02_forA_LabviewV03_CM_double 0 0 -1.7E+308 1.7E+308 ECU_ADDRESS 0x40001148 /end MEASUREMENT
/begin MEASUREMENT M3Drive "" FLOAT64_IEEE DDCU_wxt_v02_forA_LabviewV03_CM_double 0 0 -1.7E+308 1.7E+308 ECU_ADDRESS 0x40001278 /end MEASUREMENT
/begin MEASUREMENT M4Enable1 "" FLOAT64_IEEE DDCU_wxt_v02_forA_LabviewV03_CM_double 0 0 -1.7E+308 1.7E+308 ECU_ADDRESS 0x40001150 /end MEASUREMENT
/begin MEASUREMENT M4TorqueSet "" FLOAT64_IEEE DDCU_wxt_v02_forA_LabviewV03_CM_double 0 0 -1.7E+308 1.7E+308 ECU_ADDRESS 0x40001130 /end MEASUREMENT
/begin MEASUREMENT M4Mode "" FLOAT64_IEEE DDCU_wxt_v02_forA_LabviewV03_CM_double 0 0 -1.7E+308 1.7E+308 ECU_ADDRESS 0x40001158 /end MEASUREMENT
/begin MEASUREMENT M4Drive "" FLOAT64_IEEE DDCU_wxt_v02_forA_LabviewV03_CM_double 0 0 -1.7E+308 1.7E+308 ECU_ADDRESS 0x400011c0 /end MEASUREMENT
/begin MEASUREMENT bra_pre_l "" FLOAT64_IEEE DDCU_wxt_v02_forA_LabviewV03_CM_double 0 0 -1.7E+308 1.7E+308 ECU_ADDRESS 0x40001160 /end MEASUREMENT
/begin MEASUREMENT bra_pre_r "" FLOAT64_IEEE DDCU_wxt_v02_forA_LabviewV03_CM_double 0 0 -1.7E+308 1.7E+308 ECU_ADDRESS 0x400012b8 /end MEASUREMENT
/begin MEASUREMENT steer_dem "" FLOAT32_IEEE DDCU_wxt_v02_forA_LabviewV03_CM_single 0 0 -3.4E+38 3.4E+38 ECU_ADDRESS 0x400011ac /end MEASUREMENT
/begin MEASUREMENT M3Torque "" FLOAT32_IEEE DDCU_wxt_v02_forA_LabviewV03_CM_single 0 0 -3.4E+38 3.4E+38 ECU_ADDRESS 0x400012d4 /end MEASUREMENT
/begin MEASUREMENT M3FaultGrade "" FLOAT32_IEEE DDCU_wxt_v02_forA_LabviewV03_CM_single 0 0 -3.4E+38 3.4E+38 ECU_ADDRESS 0x4000129c /end MEASUREMENT
/begin MEASUREMENT M3TqLimit "" FLOAT32_IEEE DDCU_wxt_v02_forA_LabviewV03_CM_single 0 0 -3.4E+38 3.4E+38 ECU_ADDRESS 0x40001288 /end MEASUREMENT
/begin MEASUREMENT M1Torque "" FLOAT32_IEEE DDCU_wxt_v02_forA_LabviewV03_CM_single 0 0 -3.4E+38 3.4E+38 ECU_ADDRESS 0x40001220 /end MEASUREMENT
/begin MEASUREMENT M1FaultGrade "" FLOAT32_IEEE DDCU_wxt_v02_forA_LabviewV03_CM_single 0 0 -3.4E+38 3.4E+38 ECU_ADDRESS 0x400012d0 /end MEASUREMENT
/begin MEASUREMENT M1TqLimit "" FLOAT32_IEEE DDCU_wxt_v02_forA_LabviewV03_CM_single 0 0 -3.4E+38 3.4E+38 ECU_ADDRESS 0x400012e8 /end MEASUREMENT
/begin MEASUREMENT M2Torque "" FLOAT32_IEEE DDCU_wxt_v02_forA_LabviewV03_CM_single 0 0 -3.4E+38 3.4E+38 ECU_ADDRESS 0x400012d8 /end MEASUREMENT
/begin MEASUREMENT M2FaultGrade "" FLOAT32_IEEE DDCU_wxt_v02_forA_LabviewV03_CM_single 0 0 -3.4E+38 3.4E+38 ECU_ADDRESS 0x400011e0 /end MEASUREMENT
/begin MEASUREMENT M2TqLimit "" FLOAT32_IEEE DDCU_wxt_v02_forA_LabviewV03_CM_single 0 0 -3.4E+38 3.4E+38 ECU_ADDRESS 0x4000128c /end MEASUREMENT
/begin MEASUREMENT mode_dem "" FLOAT32_IEEE DDCU_wxt_v02_forA_LabviewV03_CM_single 0 0 -3.4E+38 3.4E+38 ECU_ADDRESS 0x40001298 /end MEASUREMENT
/begin MEASUREMENT brake_dem "" FLOAT32_IEEE DDCU_wxt_v02_forA_LabviewV03_CM_single 0 0 -3.4E+38 3.4E+38 ECU_ADDRESS 0x40001238 /end MEASUREMENT
/begin MEASUREMENT M4Torque "" FLOAT32_IEEE DDCU_wxt_v02_forA_LabviewV03_CM_single 0 0 -3.4E+38 3.4E+38 ECU_ADDRESS 0x40001198 /end MEASUREMENT
/begin MEASUREMENT M4FaultGrade "" FLOAT32_IEEE DDCU_wxt_v02_forA_LabviewV03_CM_single 0 0 -3.4E+38 3.4E+38 ECU_ADDRESS 0x40001140 /end MEASUREMENT
/begin MEASUREMENT M4TqLimit "" FLOAT32_IEEE DDCU_wxt_v02_forA_LabviewV03_CM_single 0 0 -3.4E+38 3.4E+38 ECU_ADDRESS 0x40001180 /end MEASUREMENT
/begin MEASUREMENT brake_dem1 "" FLOAT32_IEEE DDCU_wxt_v02_forA_LabviewV03_CM_single 0 0 -3.4E+38 3.4E+38 ECU_ADDRESS 0x400011a8 /end MEASUREMENT
/begin MEASUREMENT M3State "" FLOAT32_IEEE DDCU_wxt_v02_forA_LabviewV03_CM_single 0 0 -3.4E+38 3.4E+38 ECU_ADDRESS 0x40001258 /end MEASUREMENT
/begin MEASUREMENT M3FaultCode "" FLOAT32_IEEE DDCU_wxt_v02_forA_LabviewV03_CM_single 0 0 -3.4E+38 3.4E+38 ECU_ADDRESS 0x40001268 /end MEASUREMENT
/begin MEASUREMENT M1State "" FLOAT32_IEEE DDCU_wxt_v02_forA_LabviewV03_CM_single 0 0 -3.4E+38 3.4E+38 ECU_ADDRESS 0x40001188 /end MEASUREMENT
/begin MEASUREMENT M1FaultCode "" FLOAT32_IEEE DDCU_wxt_v02_forA_LabviewV03_CM_single 0 0 -3.4E+38 3.4E+38 ECU_ADDRESS 0x400011f8 /end MEASUREMENT
/begin MEASUREMENT M2State "" FLOAT32_IEEE DDCU_wxt_v02_forA_LabviewV03_CM_single 0 0 -3.4E+38 3.4E+38 ECU_ADDRESS 0x40001184 /end MEASUREMENT
/begin MEASUREMENT M2FaultCode "" FLOAT32_IEEE DDCU_wxt_v02_forA_LabviewV03_CM_single 0 0 -3.4E+38 3.4E+38 ECU_ADDRESS 0x4000123c /end MEASUREMENT
/begin MEASUREMENT M4State "" FLOAT32_IEEE DDCU_wxt_v02_forA_LabviewV03_CM_single 0 0 -3.4E+38 3.4E+38 ECU_ADDRESS 0x4000119c /end MEASUREMENT
/begin MEASUREMENT M4FaultCode "" FLOAT32_IEEE DDCU_wxt_v02_forA_LabviewV03_CM_single 0 0 -3.4E+38 3.4E+38 ECU_ADDRESS 0x400011b0 /end MEASUREMENT
/begin MEASUREMENT M3InputVolt "" FLOAT64_IEEE DDCU_wxt_v02_forA_LabviewV03_CM_double 0 0 -1.7E+308 1.7E+308 ECU_ADDRESS 0x400011d0 /end MEASUREMENT
/begin MEASUREMENT VESC_BrkPMa_MPa "" FLOAT32_IEEE DDCU_wxt_v02_forA_LabviewV03_CM_single 0 0 -3.4E+38 3.4E+38 ECU_ADDRESS 0x400012c0 /end MEASUREMENT
/begin COMPU_METHOD /* Name of CompuMethod */ DDCU_wxt_v02_forA_LabviewV03_CM_double "Q = V" /* Conversion Type */ RAT_FUNC /* Format */ "%15.10" /* Units */ "" /* Coefficients */ COEFFS 0 1 0 0 0 1 /end COMPU_METHOD
/begin COMPU_METHOD /* Name of CompuMethod */ DDCU_wxt_v02_forA_LabviewV03_CM_single "Q = V" /* Conversion Type */ RAT_FUNC /* Format */ "%8.6" /* Units */ "" /* Coefficients */ COEFFS 0 1 0 0 0 1 /end COMPU_METHOD
/begin GROUP DDCU_wxt_v02_forA_LabviewV03 "DDCU_wxt_v02_forA_LabviewV03" /* Root */ ROOT
 /begin SUB_GROUP Root_InputSignalProcess Root_MainControl Root_OutputSignalProcess /end SUB_GROUP
 /begin REF_MEASUREMENT M3InputVolt VESC_BrkPMa_MPa /end REF_MEASUREMENT
/end GROUP
/begin GROUP Root_InputSignalProcess "DDCU_wxt_v02_forA_LabviewV03/InputSignalProcess"
 /begin REF_MEASUREMENT M1FaultCode M1FaultGrade M1Speed M1State M1Torque M1TqLimit M2FaultCode M2FaultGrade M2Speed M2State M2Torque M2TqLimit M3FaultCode M3FaultGrade M3Speed M3State M3Torque M3TqLimit M4FaultCode M4FaultGrade M4Speed M4State M4Torque M4TqLimit acc_dem brake_dem brake_dem1 brake_emerg daodang guzhang_lf guzhang_rr kongdang mode_dem mode_dem1 qianjin steer_dem steer_dem1 zhongxinzhuanxiang zhuche /end REF_MEASUREMENT
/end GROUP
/begin GROUP Root_MainControl "DDCU_wxt_v02_forA_LabviewV03/MainControl" /begin SUB_GROUP S3_mode_control S3_mode_switch /end SUB_GROUP /end GROUP
/begin GROUP Root_OutputSignalProcess "DDCU_wxt_v02_forA_LabviewV03/OutputSignalProcess"
 /begin REF_MEASUREMENT M1Drive M1Enable1 M1Mode M1TorqueSet M2Drive M2Enable1 M2Mode M2TorqueSet M3Drive M3Enable1 M3Mode M3TorqueSet M4Drive M4Enable1 M4Mode M4TorqueSet bra_pre_l bra_pre_r /end REF_MEASUREMENT
/end GROUP
/begin GROUP S3_mode_control "DDCU_wxt_v02_forA_LabviewV03/MainControl/mode_control" /begin SUB_GROUP S124_forward /end SUB_GROUP /end GROUP
/begin GROUP S3_mode_switch "DDCU_wxt_v02_forA_LabviewV03/MainControl/mode_switch" /begin REF_MEASUREMENT mode_dem_out /end REF_MEASUREMENT /end GROUP
/begin GROUP S124_forward "DDCU_wxt_v02_forA_LabviewV03/MainControl/mode_control/forward" /begin SUB_GROUP S130_forward /end SUB_GROUP /end GROUP
/begin GROUP S130_forward "DDCU_wxt_v02_forA_LabviewV03/MainControl/mode_control/forward/forward" /begin SUB_GROUP S251_Drive /end SUB_GROUP /end GROUP
/begin GROUP S251_Drive "DDCU_wxt_v02_forA_LabviewV03/MainControl/mode_control/forward/forward/Drive" /begin SUB_GROUP S253_____ /end SUB_GROUP /end GROUP
/begin GROUP S253_____ "DDCU_wxt_v02_forA_LabviewV03/MainControl/mode_control/forward/forward/Drive/ÈÝ´í¿ØÖÆ" /begin REF_MEASUREMENT aa ab ac ad /end REF_MEASUREMENT /end GROUP
/end MODULE
/end PROJECT
/* (add any file trailer comments here) */
/* EOF DDCU_wxt_v02_forA_LabviewV03.a2l */
