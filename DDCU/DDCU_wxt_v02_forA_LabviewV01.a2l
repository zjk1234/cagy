/******************************************************************************
* ASAP2 file: DDCU_wxt_v02_forA_LabviewV01.a2l
* Code generation for model "DDCU_wxt_v02_forA_LabviewV01".
* Model version : 1.663
* Simulink Coder version : 8.6 (R2014a) 27-Dec-2013
* C source code generated on : Wed Mar 13 21:35:38 2019
* Target selection: ec5744.tlc
* Embedded hardware selection: Freescale MPC5500
* Code generation objectives: Unspecified
* Validation result: Not run
* (add additional file header information here)
******************************************************************************/ ASAP2_VERSION 1 31
/* Version 1.31 */
/begin PROJECT ECUCoderProject "ECUCoder Project"
/begin HEADER "Header Comments go here" /end HEADER
/begin MODULE ModuleName "No Comment"
/begin MOD_PAR "No Comment" /end MOD_PAR
/begin MOD_COMMON "No Comment" BYTE_ORDER MSB_FIRST /end MOD_COMMON
/begin RECORD_LAYOUT Scalar_BOOLEAN FNC_VALUES 1 UBYTE COLUMN_DIR DIRECT /end RECORD_LAYOUT
/begin RECORD_LAYOUT Scalar_UBYTE FNC_VALUES 1 UBYTE COLUMN_DIR DIRECT /end RECORD_LAYOUT
/begin RECORD_LAYOUT Scalar_BYTE FNC_VALUES 1 SBYTE COLUMN_DIR DIRECT /end RECORD_LAYOUT
/begin RECORD_LAYOUT Scalar_UWORD FNC_VALUES 1 UWORD COLUMN_DIR DIRECT /end RECORD_LAYOUT
/begin RECORD_LAYOUT Scalar_SWORD FNC_VALUES 1 SWORD COLUMN_DIR DIRECT /end RECORD_LAYOUT
/begin RECORD_LAYOUT Scalar_ULONG FNC_VALUES 1 ULONG COLUMN_DIR DIRECT /end RECORD_LAYOUT
/begin RECORD_LAYOUT Scalar_LONG FNC_VALUES 1 SLONG COLUMN_DIR DIRECT /end RECORD_LAYOUT
/begin RECORD_LAYOUT Scalar_FLOAT32_IEEE FNC_VALUES 1 FLOAT32_IEEE COLUMN_DIR DIRECT /end RECORD_LAYOUT
/begin RECORD_LAYOUT Scalar_FLOAT64_IEEE FNC_VALUES 1 FLOAT64_IEEE COLUMN_DIR DIRECT /end RECORD_LAYOUT
/begin RECORD_LAYOUT Lookup1D_BYTE FNC_VALUES 1 SBYTE COLUMN_DIR DIRECT /end RECORD_LAYOUT
/begin RECORD_LAYOUT Lookup1D_X_BYTE AXIS_PTS_X 1 SBYTE INDEX_INCR DIRECT /end RECORD_LAYOUT
/begin RECORD_LAYOUT Lookup1D_UBYTE FNC_VALUES 1 UBYTE COLUMN_DIR DIRECT /end RECORD_LAYOUT
/begin RECORD_LAYOUT Lookup1D_X_UBYTE AXIS_PTS_X 1 UBYTE INDEX_INCR DIRECT /end RECORD_LAYOUT
/begin RECORD_LAYOUT Lookup1D_UWORD FNC_VALUES 1 UWORD COLUMN_DIR DIRECT /end RECORD_LAYOUT
/begin RECORD_LAYOUT Lookup1D_X_UWORD AXIS_PTS_X 1 UWORD INDEX_INCR DIRECT /end RECORD_LAYOUT
/begin RECORD_LAYOUT Lookup1D_WORD FNC_VALUES 1 SWORD COLUMN_DIR DIRECT /end RECORD_LAYOUT
/begin RECORD_LAYOUT Lookup1D_X_WORD AXIS_PTS_X 1 SWORD INDEX_INCR DIRECT /end RECORD_LAYOUT
/begin RECORD_LAYOUT Lookup1D_ULONG FNC_VALUES 1 ULONG COLUMN_DIR DIRECT /end RECORD_LAYOUT
/begin RECORD_LAYOUT Lookup1D_X_ULONG AXIS_PTS_X 1 ULONG INDEX_INCR DIRECT /end RECORD_LAYOUT
/begin RECORD_LAYOUT Lookup1D_SLONG FNC_VALUES 1 SLONG COLUMN_DIR DIRECT /end RECORD_LAYOUT
/begin RECORD_LAYOUT Lookup1D_X_LONG AXIS_PTS_X 1 SLONG INDEX_INCR DIRECT /end RECORD_LAYOUT
/begin RECORD_LAYOUT Lookup1D_FLOAT32_IEEE FNC_VALUES 1 FLOAT32_IEEE COLUMN_DIR DIRECT /end RECORD_LAYOUT
/begin RECORD_LAYOUT Lookup1D_X_FLOAT32_IEEE AXIS_PTS_X 1 FLOAT32_IEEE INDEX_INCR DIRECT /end RECORD_LAYOUT
/begin RECORD_LAYOUT Lookup1D_FLOAT64_IEEE FNC_VALUES 1 FLOAT64_IEEE COLUMN_DIR DIRECT /end RECORD_LAYOUT
/begin RECORD_LAYOUT Lookup1D_X_FLOAT64_IEEE AXIS_PTS_X 1 FLOAT64_IEEE INDEX_INCR DIRECT /end RECORD_LAYOUT
/begin RECORD_LAYOUT Lookup2D_UBYTE FNC_VALUES 1 UBYTE COLUMN_DIR DIRECT /end RECORD_LAYOUT
/begin RECORD_LAYOUT Lookup2D_X_UBYTE AXIS_PTS_X 1 UBYTE INDEX_INCR DIRECT /end RECORD_LAYOUT
/begin RECORD_LAYOUT Lookup2D_BYTE FNC_VALUES 1 SBYTE COLUMN_DIR DIRECT /end RECORD_LAYOUT
/begin RECORD_LAYOUT Lookup2D_X_BYTE AXIS_PTS_X 1 SBYTE INDEX_INCR DIRECT /end RECORD_LAYOUT
/begin RECORD_LAYOUT Lookup2D_UWORD FNC_VALUES 1 UWORD COLUMN_DIR DIRECT /end RECORD_LAYOUT
/begin RECORD_LAYOUT Lookup2D_X_UWORD AXIS_PTS_X 1 UWORD INDEX_INCR DIRECT /end RECORD_LAYOUT
/begin RECORD_LAYOUT Lookup2D_WORD FNC_VALUES 1 SWORD COLUMN_DIR DIRECT /end RECORD_LAYOUT
/begin RECORD_LAYOUT Lookup2D_X_WORD AXIS_PTS_X 1 SWORD INDEX_INCR DIRECT /end RECORD_LAYOUT
/begin RECORD_LAYOUT Lookup2D_ULONG FNC_VALUES 1 ULONG COLUMN_DIR DIRECT /end RECORD_LAYOUT
/begin RECORD_LAYOUT Lookup2D_X_ULONG AXIS_PTS_X 1 ULONG INDEX_INCR DIRECT /end RECORD_LAYOUT
/begin RECORD_LAYOUT Lookup2D_LONG FNC_VALUES 1 SLONG COLUMN_DIR DIRECT /end RECORD_LAYOUT
/begin RECORD_LAYOUT Lookup2D_X_LONG AXIS_PTS_X 1 SLONG INDEX_INCR DIRECT /end RECORD_LAYOUT
/begin RECORD_LAYOUT Lookup2D_FLOAT32_IEEE FNC_VALUES 1 FLOAT32_IEEE COLUMN_DIR DIRECT /end RECORD_LAYOUT
/begin RECORD_LAYOUT Lookup2D_X_FLOAT32_IEEE AXIS_PTS_X 1 FLOAT32_IEEE INDEX_INCR DIRECT /end RECORD_LAYOUT
/begin RECORD_LAYOUT Lookup2D_FLOAT64_IEEE FNC_VALUES 1 FLOAT64_IEEE COLUMN_DIR DIRECT /end RECORD_LAYOUT
/begin RECORD_LAYOUT Lookup2D_X_FLOAT64_IEEE AXIS_PTS_X 1 FLOAT64_IEEE INDEX_INCR DIRECT /end RECORD_LAYOUT
/begin MEASUREMENT turn "" FLOAT64_IEEE DDCU_wxt_v02_forA_LabviewV01_CM_double 0 0 -1.7E+308 1.7E+308 ECU_ADDRESS 0x40001178 /end MEASUREMENT
/begin MEASUREMENT pwr_limit "" FLOAT64_IEEE DDCU_wxt_v02_forA_LabviewV01_CM_double 0 0 -1.7E+308 1.7E+308 ECU_ADDRESS 0x40001170 /end MEASUREMENT
/begin MEASUREMENT spd_mot_rr "" FLOAT64_IEEE DDCU_wxt_v02_forA_LabviewV01_CM_double 0 0 -1.7E+308 1.7E+308 ECU_ADDRESS 0x400011d0 /end MEASUREMENT
/begin MEASUREMENT spd_mot_rf "" FLOAT64_IEEE DDCU_wxt_v02_forA_LabviewV01_CM_double 0 0 -1.7E+308 1.7E+308 ECU_ADDRESS 0x40001150 /end MEASUREMENT
/begin MEASUREMENT spd_mot_lr "" FLOAT64_IEEE DDCU_wxt_v02_forA_LabviewV01_CM_double 0 0 -1.7E+308 1.7E+308 ECU_ADDRESS 0x40001140 /end MEASUREMENT
/begin MEASUREMENT spd_mot_lf "" FLOAT64_IEEE DDCU_wxt_v02_forA_LabviewV01_CM_double 0 0 -1.7E+308 1.7E+308 ECU_ADDRESS 0x40001190 /end MEASUREMENT
/begin MEASUREMENT acc "" FLOAT64_IEEE DDCU_wxt_v02_forA_LabviewV01_CM_double 0 0 -1.7E+308 1.7E+308 ECU_ADDRESS 0x40001138 /end MEASUREMENT
/begin MEASUREMENT real_velocity "" FLOAT64_IEEE DDCU_wxt_v02_forA_LabviewV01_CM_double 0 0 -1.7E+308 1.7E+308 ECU_ADDRESS 0x400011a0 /end MEASUREMENT
/begin MEASUREMENT kongdang "" FLOAT64_IEEE DDCU_wxt_v02_forA_LabviewV01_CM_double 0 0 -1.7E+308 1.7E+308 ECU_ADDRESS 0x40001198 /end MEASUREMENT
/begin MEASUREMENT daodang "" FLOAT64_IEEE DDCU_wxt_v02_forA_LabviewV01_CM_double 0 0 -1.7E+308 1.7E+308 ECU_ADDRESS 0x40001160 /end MEASUREMENT
/begin MEASUREMENT mode_dem "" FLOAT64_IEEE DDCU_wxt_v02_forA_LabviewV01_CM_double 0 0 -1.7E+308 1.7E+308 ECU_ADDRESS 0x400011a8 /end MEASUREMENT
/begin MEASUREMENT M1TorqueSet "" FLOAT64_IEEE DDCU_wxt_v02_forA_LabviewV01_CM_double 0 0 -1.7E+308 1.7E+308 ECU_ADDRESS 0x400011c0 /end MEASUREMENT
/begin MEASUREMENT M2TorqueSet "" FLOAT64_IEEE DDCU_wxt_v02_forA_LabviewV01_CM_double 0 0 -1.7E+308 1.7E+308 ECU_ADDRESS 0x40001180 /end MEASUREMENT
/begin MEASUREMENT M3TorqueSet "" FLOAT64_IEEE DDCU_wxt_v02_forA_LabviewV01_CM_double 0 0 -1.7E+308 1.7E+308 ECU_ADDRESS 0x400011b0 /end MEASUREMENT
/begin MEASUREMENT M4TorqueSet "" FLOAT64_IEEE DDCU_wxt_v02_forA_LabviewV01_CM_double 0 0 -1.7E+308 1.7E+308 ECU_ADDRESS 0x40001130 /end MEASUREMENT
/begin MEASUREMENT bra_pre_l "" FLOAT64_IEEE DDCU_wxt_v02_forA_LabviewV01_CM_double 0 0 -1.7E+308 1.7E+308 ECU_ADDRESS 0x40001148 /end MEASUREMENT
/begin MEASUREMENT bra_pre_r "" FLOAT64_IEEE DDCU_wxt_v02_forA_LabviewV01_CM_double 0 0 -1.7E+308 1.7E+308 ECU_ADDRESS 0x400011b8 /end MEASUREMENT
/begin MEASUREMENT breakyg "" FLOAT32_IEEE DDCU_wxt_v02_forA_LabviewV01_CM_single 0 0 -3.4E+38 3.4E+38 ECU_ADDRESS 0x400011c8 /end MEASUREMENT
/begin MEASUREMENT zhuche "" FLOAT32_IEEE DDCU_wxt_v02_forA_LabviewV01_CM_single 0 0 -3.4E+38 3.4E+38 ECU_ADDRESS 0x40001168 /end MEASUREMENT
/begin MEASUREMENT zhongxinzhuanxiang "" FLOAT32_IEEE DDCU_wxt_v02_forA_LabviewV01_CM_single 0 0 -3.4E+38 3.4E+38 ECU_ADDRESS 0x40001188 /end MEASUREMENT
/begin MEASUREMENT qianjin "" FLOAT32_IEEE DDCU_wxt_v02_forA_LabviewV01_CM_single 0 0 -3.4E+38 3.4E+38 ECU_ADDRESS 0x40001158 /end MEASUREMENT
/begin COMPU_METHOD /* Name of CompuMethod */ DDCU_wxt_v02_forA_LabviewV01_CM_double "Q = V" /* Conversion Type */ RAT_FUNC /* Format */ "%15.10" /* Units */ "" /* Coefficients */ COEFFS 0 1 0 0 0 1 /end COMPU_METHOD
/begin COMPU_METHOD /* Name of CompuMethod */ DDCU_wxt_v02_forA_LabviewV01_CM_single "Q = V" /* Conversion Type */ RAT_FUNC /* Format */ "%8.6" /* Units */ "" /* Coefficients */ COEFFS 0 1 0 0 0 1 /end COMPU_METHOD
/begin GROUP DDCU_wxt_v02_forA_LabviewV01 "DDCU_wxt_v02_forA_LabviewV01" /* Root */ ROOT /begin SUB_GROUP Root_InputSignalProcess Root_OutputSignalProcess /end SUB_GROUP /end GROUP
/begin GROUP Root_InputSignalProcess "DDCU_wxt_v02_forA_LabviewV01/InputSignalProcess" /begin SUB_GROUP S2_Subsystem /end SUB_GROUP
 /begin REF_MEASUREMENT acc breakyg daodang kongdang pwr_limit qianjin real_velocity spd_mot_lf spd_mot_lr spd_mot_rf spd_mot_rr turn zhongxinzhuanxiang zhuche /end REF_MEASUREMENT
/end GROUP
/begin GROUP Root_OutputSignalProcess "DDCU_wxt_v02_forA_LabviewV01/OutputSignalProcess"
 /begin REF_MEASUREMENT M1TorqueSet M2TorqueSet M3TorqueSet M4TorqueSet bra_pre_l bra_pre_r /end REF_MEASUREMENT
/end GROUP
/begin GROUP S2_Subsystem "DDCU_wxt_v02_forA_LabviewV01/InputSignalProcess/Subsystem" /begin REF_MEASUREMENT mode_dem /end REF_MEASUREMENT /end GROUP
/end MODULE
/end PROJECT
/* (add any file trailer comments here) */
/* EOF DDCU_wxt_v02_forA_LabviewV01.a2l */
